## boards/shields/sofle-tb/Kconfig.defconfig
```kconfig
if SHIELD_SOFLE_TB_RIGHT

# Name must be less than 16 characters long!
config ZMK_KEYBOARD_NAME
    default "Sofle Trackball"

config ZMK_SPLIT_ROLE_CENTRAL
    default y

endif

if SHIELD_SOFLE_TB_LEFT || SHIELD_SOFLE_TB_RIGHT

config ZMK_SPLIT
    default y

endif
```

## config/west.yml
```yaml
manifest:
  remotes:
    - name: badjeff
      url-base: https://github.com/badjeff
  projects:
    - name: zmk-pmw3160-driver
      remote: badjeff
      revision: main
  self:
    path: config
```
